## boards/shields/project_sbo/Kconfig.defconfig
```kconfig
# Copyright (c) 2022 The ZMK Contributors
# SPDX-License-Identifier: MIT

if SHIELD_PROJECT_SBO

config ZMK_KEYBOARD_NAME
    default "Project SBO"

endif
```

## boards/shields/project_sbo/Kconfig.shield
```kconfig
# Copyright (c) 2022 The ZMK Contributors
# SPDX-License-Identifier: MIT

config SHIELD_PROJECT_SBO
   def_bool $(shields_list_contains,project_sbo)
```
